## CMakeLists.txt
```
#
# Copyright (c) 2020 Nordic Semiconductor ASA
#
# SPDX-License-Identifier: LicenseRef-Nordic-5-Clause
#
cmake_minimum_required(VERSION 3.20.0)

find_package(Zephyr REQUIRED HINTS $ENV{ZEPHYR_BASE})
project(bluetooth_mesh_light_ctrl)

# NORDIC SDK APP START
target_sources(app PRIVATE
  src/main.c
  src/model_handler.c
  src/lc_pwm_led.c
)

if(CONFIG_LIGHT_CTRL_ZMS_FOOTPRINT_DBG)
  target_sources(app PRIVATE src/zms_footprint_dbg.c)
endif()

target_include_directories(app PRIVATE include)
# NORDIC SDK APP END
```

## Kconfig
```
#
# Copyright (c) 2026 Nordic Semiconductor ASA
#
# SPDX-License-Identifier: LicenseRef-Nordic-5-Clause
#

source "Kconfig.zephyr"

menu "Bluetooth Mesh light_ctrl sample"

config LIGHT_CTRL_ZMS_FOOTPRINT_DBG
	bool "ZMS settings footprint dump on button press"
	depends on SETTINGS && SETTINGS_ZMS
	help
	  Temporary debug: on Button 2 (nRF54L15 DK), print tabular ZMS footprint
	  for mesh settings (non-RPL) and RPL in separate tables, plus summary.

endmenu
```

## prj.conf
```kconfig
#
# Copyright (c) 2020 Nordic Semiconductor ASA
#
# SPDX-License-Identifier: LicenseRef-Nordic-5-Clause
#
CONFIG_NCS_SAMPLES_DEFAULTS=y

# Deferred logging helps improve LPN power consumption
# when friendship is established.
CONFIG_LOG_MODE_DEFERRED=y

# General configuration
CONFIG_NCS_APPLICATION_BOOT_BANNER_STRING="Mesh Light Fixture"
CONFIG_SYSTEM_WORKQUEUE_STACK_SIZE=2048
CONFIG_FLASH=y
CONFIG_FLASH_MAP=y
CONFIG_NVS=y
CONFIG_NVS_LOOKUP_CACHE=y
CONFIG_SETTINGS=y
CONFIG_SETTINGS_NVS_NAME_CACHE=y
CONFIG_HWINFO=y
CONFIG_DK_LIBRARY=y
CONFIG_PWM=y
CONFIG_SOC_FLASH_NRF_PARTIAL_ERASE=y

# Bluetooth configuration
CONFIG_BT=y
CONFIG_BT_DEVICE_NAME="Mesh Light Fixture"
CONFIG_BT_L2CAP_TX_BUF_COUNT=8
CONFIG_BT_OBSERVER=y
CONFIG_BT_PERIPHERAL=y

# Disable unused Bluetooth features
CONFIG_BT_CTLR_LE_ENC=n
CONFIG_BT_PHY_UPDATE=n
CONFIG_BT_CTLR_CHAN_SEL_2=n
CONFIG_BT_CTLR_MIN_USED_CHAN=n
CONFIG_BT_CTLR_PRIVACY=n

# Bluetooth Mesh configuration
CONFIG_BT_MESH=y
CONFIG_BT_MESH_RELAY=y
CONFIG_BT_MESH_FRIEND=y
CONFIG_BT_MESH_FRIEND_RECV_WIN=15
CONFIG_BT_MESH_FRIEND_LOG_LEVEL_DBG=y
CONFIG_BT_MESH_TX_SEG_MAX=10
CONFIG_BT_MESH_PB_GATT=y
CONFIG_BT_MESH_PROXY_USE_DEVICE_NAME=y
CONFIG_BT_MESH_GATT_PROXY=y
CONFIG_BT_MESH_ADV_EXT_GATT_SEPARATE=y
CONFIG_BT_MESH_DK_PROV=y
CONFIG_BT_MESH_NLC_PERF_LIGHTNESS_CTRL=y
CONFIG_BT_MESH_NLC_PERF_ENERGY_MONITOR=y
CONFIG_BT_MESH_MODEL_EXTENSIONS=y
CONFIG_BT_MESH_MODEL_EXTENSION_LIST_SIZE=18
# Enabling NLC Lightness Controller profile enables support for 3 application keys by
# default. Therefore, allow up to 3 application key bindings per model instance.
CONFIG_BT_MESH_MODEL_KEY_COUNT=3

# Bluetooth Mesh models
CONFIG_BT_MESH_LIGHT_CTRL_SRV=y
CONFIG_BT_MESH_LIGHT_CTRL_SRV_TIME_ON=3
CONFIG_BT_MESH_LIGHT_CTRL_SRV_TIME_PROLONG=3
CONFIG_BT_MESH_LIGHT_CTRL_SRV_RESUME_DELAY=30
CONFIG_BT_MESH_SCENE_SRV=y
CONFIG_BT_MESH_SENSOR_SRV=y
```

## overlay-zms-footprint.conf
```kconfig
#
# Copyright (c) 2026 Nordic Semiconductor ASA
#
# SPDX-License-Identifier: LicenseRef-Nordic-5-Clause
#
# ZMS settings backend + footprint debug dump (nRF54L15 DK experiment).
#

CONFIG_NVS=n
CONFIG_NVS_LOOKUP_CACHE=n
CONFIG_SETTINGS_NVS_NAME_CACHE=n
CONFIG_ZMS=y
CONFIG_SETTINGS_ZMS_CUSTOM_SECTOR_COUNT=y
CONFIG_SETTINGS_ZMS_SECTOR_COUNT=8
CONFIG_ZMS_LOOKUP_CACHE=y
CONFIG_ZMS_LOOKUP_CACHE_SIZE=512
CONFIG_ZMS_LOOKUP_CACHE_FOR_SETTINGS=y
CONFIG_LIGHT_CTRL_ZMS_FOOTPRINT_DBG=y
```

## src/main.c
```c
/*
 * Copyright (c) 2020 Nordic Semiconductor ASA
 *
 * SPDX-License-Identifier: LicenseRef-Nordic-5-Clause
 */

/** @file
 *  @brief Nordic mesh light fixture sample
 */
#include <zephyr/logging/log_ctrl.h>
#include <zephyr/bluetooth/bluetooth.h>
#include <bluetooth/mesh/models.h>
#include <bluetooth/mesh/dk_prov.h>
#include <dk_buttons_and_leds.h>
#include "model_handler.h"
#include "lc_pwm_led.h"

#if IS_ENABLED(CONFIG_LIGHT_CTRL_ZMS_FOOTPRINT_DBG)
#include <zephyr/bluetooth/mesh/main.h>
#include "zms_footprint_dbg.h"
#endif

#ifdef CONFIG_EMDS
#include <emds/emds.h>

#if defined(CONFIG_HAS_BT_CTLR)
#include <mpsl/mpsl_lib.h>
#endif

#if defined(CONFIG_SOC_SERIES_NRF52)
	#define EMDS_DEV_IRQ SWI1_EGU1_IRQn
#elif defined(CONFIG_SOC_SERIES_NRF53)
	#define EMDS_DEV_IRQ EGU1_IRQn
#elif defined(CONFIG_SOC_SERIES_NRF54L)
	#define EMDS_DEV_IRQ SWI01_IRQn
#endif

#define EMDS_DEV_PRIO 0
#define EMDS_ISR_ARG 0
#define EMDS_IRQ_FLAGS 0

static void button_handler_cb(uint32_t pressed, uint32_t changed)
{
	if (pressed & changed & BIT(3)) {
		NVIC_SetPendingIRQ(EMDS_DEV_IRQ);
	}
}

static void app_emds_cb(void)
{
	/* The sample did not call bt_disable and stop the Bluetooth stack properly.
	 * Therefore, the device does not work any longer and needs reboot.
	 */
	/* Flush logs before halting. */
	log_panic();
	dk_set_leds(DK_LED2_MSK | DK_LED3_MSK | DK_LED4_MSK);
	k_fatal_halt(K_ERR_CPU_EXCEPTION);
}

static void isr_emds_cb(void *arg)
{
	ARG_UNUSED(arg);

#if defined(CONFIG_HAS_BT_CTLR)
	/* The sample does not stop the SoftDevice Controller here because the device expects
	 * a system reset after EMDS completes storing.
	 */
	int32_t err = mpsl_lib_uninit();

	if (err != 0) {
		printk("Could not stop MPSL (err %d)\n", err);
	}
#endif

	emds_store();
}
#endif

#ifdef CONFIG_EMDS
static void node_reset_handler(void)
{
	printk("Node reset\n");

	/* Upon node reset, clear the EMDS so that stale RPL data, if any, is removed.
	 *
	 * If you don't want to clear the EMDS data for application specific reasons, you must then
	 * call emds_store() to save the current state of RPL (which is cleared internally by the
	 * system) and that of application specific data, if any. See @ref emds_store() for more
	 * details.
	 */
	int err = emds_clear();

	if (err) {
		printk("EMDS clear failed (err %d)\n", err);
	}
}
#endif

#if IS_ENABLED(CONFIG_LIGHT_CTRL_ZMS_FOOTPRINT_DBG)
static void zms_footprint_button_cb(uint32_t pressed, uint32_t changed)
{
	if ((pressed & changed & BIT(1)) && bt_mesh_is_provisioned()) {
		zms_footprint_dbg_dump();
	}
}
#endif

static void bt_ready(int err)
{
	if (err) {
		printk("Bluetooth init failed (err %d)\n", err);
		return;
	}

	printk("Bluetooth initialized\n");

	err = dk_leds_init();
	if (err) {
		printk("Initializing LEDs failed (err %d)\n", err);
		return;
	}

	err = dk_buttons_init(NULL);
	if (err) {
		printk("Initializing buttons failed (err %d)\n", err);
		return;
	}

#ifdef CONFIG_EMDS
	static struct button_handler button_handler = {
		.cb = button_handler_cb,
	};

	dk_button_handler_add(&button_handler);

	err = emds_init(&app_emds_cb);
	if (err) {
		printk("Initializing emds failed (err %d)\n", err);
		return;
	}

	bt_mesh_dk_prov_node_reset_cb_set(node_reset_handler);
#endif

	err = bt_mesh_init(bt_mesh_dk_prov_init(), model_handler_init());
	if (err) {
		printk("Initializing mesh failed (err %d)\n", err);
		return;
	}

#ifdef CONFIG_EMDS
	err = emds_load();
	if (err && err != -ENOENT) {
		printk("Restore of emds data failed (err %d)\n", err);
		return;
	} else if (err == -ENOENT) {
		printk("No valid emds data found, starting fresh\n");
	} else {
		printk("Restored emds data successfully\n");
	}

	err = emds_prepare();
	if (err) {
		printk("Preparation emds failed (err %d)\n", err);
		return;
	}

	IRQ_CONNECT(EMDS_DEV_IRQ, EMDS_DEV_PRIO, isr_emds_cb,
		    EMDS_ISR_ARG, EMDS_IRQ_FLAGS);
	irq_enable(EMDS_DEV_IRQ);
#endif

	if (IS_ENABLED(CONFIG_SETTINGS)) {
		settings_load();
	}

#if IS_ENABLED(CONFIG_LIGHT_CTRL_ZMS_FOOTPRINT_DBG)
	{
		static struct button_handler zms_fp_btn = {
			.cb = zms_footprint_button_cb,
		};

		dk_button_handler_add(&zms_fp_btn);
	}
#endif

	/* This will be a no-op if settings_load() loaded provisioning info */
	bt_mesh_prov_enable(BT_MESH_PROV_ADV | BT_MESH_PROV_GATT);

	printk("Mesh initialized\n");

	model_handler_start();
}

int main(void)
{
	int err;

	printk("Initializing...\n");
	lc_pwm_led_init();
	err = bt_enable(bt_ready);
	if (err) {
		printk("Bluetooth init failed (err %d)\n", err);
	}

	return 0;
}
```

## src/model_handler.c
```c
/*
 * Copyright (c) 2020 Nordic Semiconductor ASA
 *
 * SPDX-License-Identifier: LicenseRef-Nordic-5-Clause
 */

#include <zephyr/bluetooth/bluetooth.h>
#include <bluetooth/mesh/models.h>
#include <dk_buttons_and_leds.h>
#include "model_handler.h"
#include "lc_pwm_led.h"

#define PWM_SIZE_STEP 512

struct lightness_ctx {
	struct bt_mesh_lightness_srv lightness_srv;
	struct k_work_delayable per_work;
	uint16_t target_lvl;
	uint16_t current_lvl;
	uint32_t time_per;
	uint32_t rem_time;
};

#if IS_ENABLED(CONFIG_BT_MESH_NLC_PERF_BASELINE)
static const uint8_t cmp2_elem_offset1[2] = { 0, 1 };
static const uint8_t cmp2_elem_offset2[1] = { 0 };

static const struct bt_mesh_comp2_record comp_rec[2] = {
	{/* Basic Lightness Controller NLC Profile 1.0.1 */
	.id = BT_MESH_NLC_PROFILE_ID_BASIC_LIGHTNESS_CONTROLLER,
	.version.x = 1,
	.version.y = 0,
	.version.z = 1,
	.elem_offset_cnt = 2,
	.elem_offset = cmp2_elem_offset1,
	.data_len = 0
	},
	{ /* Energy Monitor NLC Profile 1.0.1 */
	.id = BT_MESH_NLC_PROFILE_ID_ENERGY_MONITOR,
	.version.x = 1,
	.version.y = 0,
	.version.z = 1,
	.elem_offset_cnt = 1,
	.elem_offset = cmp2_elem_offset2,
	.data_len = 0
	}
};

static const struct bt_mesh_comp2 comp_p2 = {
	.record_cnt = 2,
	.record = comp_rec
};
#endif

/* Set up a repeating delayed work to blink the DK's LEDs when attention is
 * requested.
 */
static struct k_work_delayable attention_blink_work;
static bool attention;

static void attention_blink(struct k_work *work)
{
	static int idx;
	const uint8_t pattern[] = {
#if DT_NODE_EXISTS(DT_ALIAS(led0))
		BIT(0),
#endif
#if DT_NODE_EXISTS(DT_ALIAS(led1))
		BIT(1),
#endif
#if DT_NODE_EXISTS(DT_ALIAS(led2))
		BIT(2),
#endif
#if DT_NODE_EXISTS(DT_ALIAS(led3))
		BIT(3),
#endif
	};

	if (attention) {
		dk_set_leds(pattern[idx++ % ARRAY_SIZE(pattern)]);
		k_work_reschedule(&attention_blink_work, K_MSEC(30));
	} else {
		dk_set_leds(DK_NO_LEDS_MSK);
	}
}

static void attention_on(const struct bt_mesh_model *mod)
{
	attention = true;
	k_work_reschedule(&attention_blink_work, K_NO_WAIT);
}

static void attention_off(const struct bt_mesh_model *mod)
{
	/* Will stop rescheduling blink timer */
	attention = false;
}

static const struct bt_mesh_health_srv_cb health_srv_cb = {
	.attn_on = attention_on,
	.attn_off = attention_off,
};

static struct bt_mesh_health_srv health_srv = {
	.cb = &health_srv_cb,
};

BT_MESH_HEALTH_PUB_DEFINE(health_pub, 0);

/* Generic OnOff Client on element 0, driven by button 0 */
static bool onoff_client_state;
static void onoff_cli_status_handler(struct bt_mesh_onoff_cli *cli,
				    struct bt_mesh_msg_ctx *ctx,
				    const struct bt_mesh_onoff_status *status)
{
	onoff_client_state = status->present_on_off;
	printk("Generic OnOff: %s\n", status->present_on_off ? "on" : "off");
}

static struct bt_mesh_onoff_cli onoff_cli =
	BT_MESH_ONOFF_CLI_INIT(onoff_cli_status_handler);

static void onoff_button_handler_cb(uint32_t pressed, uint32_t changed)
{
	if (!bt_mesh_is_provisioned() || !(pressed & changed & BIT(0))) {
		return;
	}
	onoff_client_state = !onoff_client_state;
	struct bt_mesh_onoff_set set = { .on_off = onoff_client_state };
	int err = bt_mesh_onoff_cli_set_unack(&onoff_cli, NULL, &set);

	if (err) {
		printk("OnOff set_unack failed: %d\n", err);
		onoff_client_state = !onoff_client_state;
	}
}

static void start_new_light_trans(const struct bt_mesh_lightness_set *set,
				  struct lightness_ctx *ctx)
{
	uint32_t step_cnt = abs(set->lvl - ctx->current_lvl) / PWM_SIZE_STEP;
	uint32_t time = set->transition ? set->transition->time : 0;
	uint32_t delay = set->transition ? set->transition->delay : 0;

	ctx->target_lvl = set->lvl;
	ctx->time_per = (step_cnt ? time / step_cnt : 0);
	ctx->rem_time = time;
	k_work_reschedule(&ctx->per_work, K_MSEC(delay));

	printk("New light transition-> Lvl: %d, Time: %d, Delay: %d\n",
	       set->lvl, time, delay);
}

static void periodic_led_work(struct k_work *work)
{
	uint16_t clamped_lvl;
	struct lightness_ctx *l_ctx =
		CONTAINER_OF(work, struct lightness_ctx, per_work.work);
	l_ctx->rem_time -= l_ctx->time_per;

	if ((l_ctx->rem_time <= l_ctx->time_per) ||
	    (abs(l_ctx->target_lvl - l_ctx->current_lvl) <= PWM_SIZE_STEP)) {
		struct bt_mesh_lightness_status status = {
			.current = l_ctx->target_lvl,
			.target = l_ctx->target_lvl,
		};

		l_ctx->current_lvl = l_ctx->target_lvl;
		l_ctx->rem_time = 0;

		bt_mesh_lightness_srv_pub(&l_ctx->lightness_srv, NULL, &status);

		goto apply_and_print;
	} else if (l_ctx->target_lvl > l_ctx->current_lvl) {
		l_ctx->current_lvl += PWM_SIZE_STEP;
	} else {
		l_ctx->current_lvl -= PWM_SIZE_STEP;
	}

	k_work_reschedule(&l_ctx->per_work, K_MSEC(l_ctx->time_per));
apply_and_print:
	clamped_lvl = bt_mesh_lightness_clamp(&l_ctx->lightness_srv, l_ctx->current_lvl);
	lc_pwm_led_set(clamped_lvl);
	printk("Current light lvl: %u/65535\n", clamped_lvl);
}

static void light_set(struct bt_mesh_lightness_srv *srv,
		      struct bt_mesh_msg_ctx *ctx,
		      const struct bt_mesh_lightness_set *set,
		      struct bt_mesh_lightness_status *rsp)
{
	struct lightness_ctx *l_ctx =
		CONTAINER_OF(srv, struct lightness_ctx, lightness_srv);

	start_new_light_trans(set, l_ctx);
	rsp->current = l_ctx->rem_time ? l_ctx->current_lvl : l_ctx->target_lvl;
	rsp->target = l_ctx->target_lvl;
	rsp->remaining_time = set->transition ? set->transition->time : 0;
}

static void light_get(struct bt_mesh_lightness_srv *srv,
		      struct bt_mesh_msg_ctx *ctx,
		      struct bt_mesh_lightness_status *rsp)
{
	struct lightness_ctx *l_ctx =
		CONTAINER_OF(srv, struct lightness_ctx, lightness_srv);

	rsp->current = bt_mesh_lightness_clamp(&l_ctx->lightness_srv, l_ctx->current_lvl);
	rsp->target = l_ctx->target_lvl;
	rsp->remaining_time = l_ctx->rem_time;
}

static const struct bt_mesh_lightness_srv_handlers lightness_srv_handlers = {
	.light_set = light_set,
	.light_get = light_get,
};

static struct lightness_ctx my_ctx = {
	.lightness_srv = BT_MESH_LIGHTNESS_SRV_INIT(&lightness_srv_handlers),

};

static int dummy_energy_use;

static int energy_use_get(struct bt_mesh_sensor_srv *srv,
			 struct bt_mesh_sensor *sensor,
			 struct bt_mesh_msg_ctx *ctx,
			 struct bt_mesh_sensor_value *rsp)
{
	/* Report energy usage as dummy value, and increase it by one every time
	 * a get callback is triggered. The logic and hardware for measuring
	 * the actual energy usage of the device should be implemented here.
	 */
	(void)bt_mesh_sensor_value_from_micro(sensor->type->channels[0].format,
					      dummy_energy_use * 1000000LL, rsp);
	dummy_energy_use++;

	return 0;
}

static const struct bt_mesh_sensor_descriptor energy_use_desc = {
	.tolerance = {
		.negative = 0,
		.positive = 0,
	},
	.sampling_type = BT_MESH_SENSOR_SAMPLING_UNSPECIFIED,
	.period = 0,
	.update_interval = 0,
};

static struct bt_mesh_sensor energy_use = {
	.type = &bt_mesh_sensor_precise_tot_dev_energy_use,
	.get = energy_use_get,
	.descriptor = &energy_use_desc,
};

static struct bt_mesh_sensor *const sensors[] = {
	&energy_use,
};

static struct bt_mesh_sensor_srv sensor_srv =
	BT_MESH_SENSOR_SRV_INIT(sensors, ARRAY_SIZE(sensors));

static struct bt_mesh_scene_srv scene_srv;

static struct bt_mesh_light_ctrl_srv light_ctrl_srv =
	BT_MESH_LIGHT_CTRL_SRV_INIT(&my_ctx.lightness_srv);

static struct bt_mesh_elem elements[] = {
	BT_MESH_ELEM(1,
		     BT_MESH_MODEL_LIST(
			     BT_MESH_MODEL_CFG_SRV,
			     BT_MESH_MODEL_HEALTH_SRV(&health_srv, &health_pub),
			     BT_MESH_MODEL_ONOFF_CLI(&onoff_cli),
			     BT_MESH_MODEL_LIGHTNESS_SRV(
					 &my_ctx.lightness_srv),
			     BT_MESH_MODEL_SCENE_SRV(&scene_srv),
			     BT_MESH_MODEL_SENSOR_SRV(&sensor_srv)),
		     BT_MESH_MODEL_NONE),
	BT_MESH_ELEM(2,
		     BT_MESH_MODEL_LIST(
			     BT_MESH_MODEL_LIGHT_CTRL_SRV(&light_ctrl_srv)),
		     BT_MESH_MODEL_NONE),
};

static const struct bt_mesh_comp comp = {
	.cid = CONFIG_BT_COMPANY_ID,
	.elem = elements,
	.elem_count = ARRAY_SIZE(elements),
};

const struct bt_mesh_comp *model_handler_init(void)
{
	static struct button_handler onoff_button_handler = {
		.cb = onoff_button_handler_cb,
	};

	dk_button_handler_add(&onoff_button_handler);
	k_work_init_delayable(&attention_blink_work, attention_blink);
	k_work_init_delayable(&my_ctx.per_work, periodic_led_work);

	return &comp;
}

void model_handler_start(void)
{
	int err;

#if IS_ENABLED(CONFIG_BT_MESH_NLC_PERF_BASELINE)
	if (bt_mesh_comp2_register(&comp_p2)) {
		printk("Failed to register comp2\n");
	}
#endif

	if (bt_mesh_is_provisioned()) {
		return;
	}

	bt_mesh_ponoff_srv_set(&light_ctrl_srv.lightness->ponoff,
			       BT_MESH_ON_POWER_UP_RESTORE);

	err = bt_mesh_light_ctrl_srv_enable(&light_ctrl_srv);
	if (!err) {
		printk("Successfully enabled LC server\n");
	}
}
```

## src/zms_footprint_dbg.c
```c
/*
 * Copyright (c) 2026 Nordic Semiconductor ASA
 *
 * SPDX-License-Identifier: LicenseRef-Nordic-5-Clause
 */

#include "zms_footprint_dbg.h"

#include <errno.h>
#include <stdio.h>
#include <string.h>

#include <zephyr/logging/log_ctrl.h>
#include <zephyr/settings/settings.h>
#include <zephyr/sys/util.h>
#include <zephyr/kvss/zms.h>
#include <zephyr/storage/flash_map.h>
#include <settings/settings_zms.h>

#define ZMS_DATA_IN_ATE_SIZE	8
#define RPL_PREFIX		"bt/mesh/RPL/"
#define RPL_PREFIX_LEN		(sizeof(RPL_PREFIX) - 1)

/* Column widths for aligned printk tables (longest mesh path is 20 chars). */
#define ZMS_FP_PATH_W		21
#define ZMS_FP_LEN_W		9
#define ZMS_FP_VALUE_PREVIEW_B	4
#define ZMS_FP_VALUE_W		8	/* up to 4 bytes -> 8 hex digits */
#define ZMS_FP_ID_W		8
#define ZMS_FP_STORE_W		10
/* "path_flash" is 10 chars; %*s still prints longer strings if width is too small. */
#define ZMS_FP_FLASH_W		10

/* Must match settings_zms.c read_fn_arg passed to load callbacks. */
struct settings_zms_read_fn_arg {
	struct zms_fs *fs;
	uint32_t id;
};

enum zms_fp_table {
	ZMS_FP_TABLE_MESH,
	ZMS_FP_TABLE_RPL,
};

struct zms_fp_ctx {
	struct zms_fs *fs;
	size_t zms_ate_len;
	size_t write_block_size;
	enum zms_fp_table table;
	uint32_t mesh_key_count;
	size_t mesh_sum_row_total;
	uint32_t rpl_key_count;
	size_t rpl_sum_row_total;
};

static size_t zms_obj_flash(struct zms_fs *fs, size_t data_len)
{
	size_t zms_ate_len = fs->ate_size;
	size_t wb = fs->flash_parameters->write_block_size;

	if (data_len > ZMS_DATA_IN_ATE_SIZE) {
		return zms_ate_len + (size_t)ROUND_UP(data_len, wb);
	}

	return zms_ate_len;
}

static size_t zms_mounted_size(struct zms_fs *fs)
{
	return (size_t)fs->sector_size * fs->sector_count;
}

static void zms_store_desc(char *buf, size_t buf_len, size_t data_len, size_t wb)
{
	if (data_len <= ZMS_DATA_IN_ATE_SIZE) {
		snprintf(buf, buf_len, "ATE");
	} else {
		size_t ext = (size_t)ROUND_UP(data_len, wb);

		snprintf(buf, buf_len, "ext %zu", ext);
	}
}

/* First bytes of settings value as hex, printed byte3..byte0 (MSB left). */
static void zms_fp_format_value_preview(struct zms_fs *fs, uint32_t val_id, size_t value_len,
					char *buf, size_t buf_len)
{
	uint8_t bytes[ZMS_FP_VALUE_PREVIEW_B];
	size_t n;
	ssize_t rc;
	char *p = buf;
	size_t rem = buf_len;

	if (buf_len == 0) {
		return;
	}

	buf[0] = '\0';

	if (value_len == 0) {
		snprintf(buf, buf_len, "-");
		return;
	}

	n = MIN(value_len, ZMS_FP_VALUE_PREVIEW_B);
	rc = zms_read(fs, val_id, bytes, n);
	if (rc < 0 || (size_t)rc < n) {
		snprintf(buf, buf_len, "?");
		return;
	}

	for (size_t i = n; i > 0; i--) {
		int w = snprintf(p, rem, "%02x", bytes[i - 1]);

		if (w < 0 || (size_t)w >= rem) {
			break;
		}

		p += w;
		rem -= (size_t)w;
	}
}

static void zms_fp_print_columns(void)
{
	printk("%-*s | %*s | %*s | %*s | %*s | %*s | %*s | %-*s | %-*s | %-*s | "
	       "%*s | %*s | %*s | %*s\n",
	       ZMS_FP_PATH_W, "path",
	       ZMS_FP_LEN_W, "path_len",
	       ZMS_FP_VALUE_W, "value",
	       ZMS_FP_LEN_W, "value_len",
	       ZMS_FP_ID_W, "path_id",
	       ZMS_FP_ID_W, "val_id",
	       ZMS_FP_ID_W, "ll_id",
	       ZMS_FP_STORE_W, "path_store",
	       ZMS_FP_STORE_W, "val_store",
	       ZMS_FP_STORE_W, "ll_store",
	       ZMS_FP_FLASH_W, "path_flash",
	       ZMS_FP_FLASH_W, "val_flash",
	       ZMS_FP_FLASH_W, "ll_flash",
	       ZMS_FP_FLASH_W, "row_total");
}

static void zms_fp_print_table_intro(const char *title)
{
	printk("\n--- %s ---\n", title);
	zms_fp_print_columns();
}

static int zms_fp_emit_row(struct zms_fp_ctx *ctx, const char *name, size_t value_len,
			   const struct settings_zms_read_fn_arg *rd)
{
	uint32_t path_id;
	uint32_t val_id;
	uint32_t ll_id;
	ssize_t path_len;
	ssize_t ll_len;
	size_t path_flash;
	size_t value_flash;
	size_t ll_flash;
	size_t row_total;
	char path_store[16];
	char val_store[16];
	char ll_store[16];
	char val_preview[(ZMS_FP_VALUE_PREVIEW_B * 2) + 1];

	val_id = rd->id;
	path_id = val_id - ZMS_DATA_ID_OFFSET;
	ll_id = ZMS_LL_NODE_FROM_NAME_ID(path_id);

	path_len = zms_get_data_length(ctx->fs, path_id);
	ll_len = zms_get_data_length(ctx->fs, ll_id);

	if (path_len < 0 || (ssize_t)value_len < 0 || ll_len < 0) {
		printk("skip (read err): %s\n", name);
		return 0;
	}

	path_flash = zms_obj_flash(ctx->fs, (size_t)path_len);
	value_flash = zms_obj_flash(ctx->fs, value_len);
	ll_flash = zms_obj_flash(ctx->fs, (size_t)ll_len);
	row_total = path_flash + value_flash + ll_flash;

	zms_store_desc(path_store, sizeof(path_store), (size_t)path_len,
		       ctx->write_block_size);
	zms_store_desc(val_store, sizeof(val_store), value_len, ctx->write_block_size);
	zms_store_desc(ll_store, sizeof(ll_store), (size_t)ll_len, ctx->write_block_size);
	zms_fp_format_value_preview(ctx->fs, val_id, value_len, val_preview,
				    sizeof(val_preview));

	printk("%-*s | %*zd | %*s | %*zu | %08x | %08x | %08x | %-*s | %-*s | %-*s | "
	       "%*zu | %*zu | %*zu | %*zu\n",
	       ZMS_FP_PATH_W, name,
	       ZMS_FP_LEN_W, path_len,
	       ZMS_FP_VALUE_W, val_preview,
	       ZMS_FP_LEN_W, value_len,
	       path_id, val_id, ll_id,
	       ZMS_FP_STORE_W, path_store,
	       ZMS_FP_STORE_W, val_store,
	       ZMS_FP_STORE_W, ll_store,
	       ZMS_FP_FLASH_W, path_flash,
	       ZMS_FP_FLASH_W, value_flash,
	       ZMS_FP_FLASH_W, ll_flash,
	       ZMS_FP_FLASH_W, row_total);

	if (ctx->table == ZMS_FP_TABLE_RPL) {
		ctx->rpl_key_count++;
		ctx->rpl_sum_row_total += row_total;
	} else {
		ctx->mesh_key_count++;
		ctx->mesh_sum_row_total += row_total;
	}

	return 0;
}

static int zms_fp_row_cb(const char *name, size_t len, settings_read_cb read_cb,
			 void *cb_arg, void *param)
{
	struct zms_fp_ctx *ctx = param;
	const struct settings_zms_read_fn_arg *rd;
	bool is_rpl;

	ARG_UNUSED(read_cb);

	is_rpl = !strncmp(name, RPL_PREFIX, RPL_PREFIX_LEN);

	if (ctx->table == ZMS_FP_TABLE_MESH && is_rpl) {
		return 0;
	}

	if (ctx->table == ZMS_FP_TABLE_RPL && !is_rpl) {
		return 0;
	}

	if (!cb_arg) {
		printk("skip (no ZMS cb_arg): %s\n", name);
		return 0;
	}

	rd = cb_arg;

	return zms_fp_emit_row(ctx, name, len, rd);
}

static void zms_fp_scan_table(struct zms_fp_ctx *ctx, enum zms_fp_table table,
			      const char *title)
{
	ctx->table = table;
	zms_fp_print_table_intro(title);
	settings_load_subtree_direct(NULL, zms_fp_row_cb, ctx);
}

void zms_footprint_dbg_dump(void)
{
	void *storage;
	struct zms_fs *fs;
	struct zms_fp_ctx ctx = { 0 };
	const struct flash_area *fa;
	ssize_t free_space;
	size_t partition_size;
	size_t mounted_size;
	size_t partition_tail;
	size_t mounted_used;
	size_t gc_reserve_size;
	size_t overhead_excl_gc;
	size_t free_space_u;
	size_t logical_sum;
	int err;

#if IS_ENABLED(CONFIG_LOG_MODE_DEFERRED)
	log_panic();
#endif

	err = settings_storage_get(&storage);
	if (err || !storage) {
		printk("ZMS footprint: settings_storage_get failed (%d)\n", err);
		return;
	}

	fs = storage;
	if (!fs->ready) {
		printk("ZMS footprint: ZMS not mounted\n");
		return;
	}

	ctx.fs = fs;
	ctx.zms_ate_len = fs->ate_size;
	ctx.write_block_size = fs->flash_parameters->write_block_size;

	printk("\n=== ZMS settings footprint ===\n");
	printk("zms_ate_len=%zu  write_block_size=%zu\n",
	       ctx.zms_ate_len, ctx.write_block_size);
	printk("Per row: path + value + LL ZMS objects (see row_total formula below).\n");
	printk("  path_flash  = zms_ate_len + ROUND_UP(path_len,wb) if path_len>8\n");
	printk("  value_flash = zms_ate_len + ROUND_UP(value_len,wb) if value_len>8\n");
	printk("  ll_flash    = zms_ate_len (LL is 8 B, in ATE)\n");
	printk("  row_total   = path_flash + value_flash + ll_flash\n");
	printk("ZMS IDs: path MSB=10; val_id=path_id+0x40000000; ll_id=path_id|1\n");
	printk("value column: first %u byte(s) as hex, printed byte3..byte0 order.\n",
	       ZMS_FP_VALUE_PREVIEW_B);
	printk("Logical footprint per table; raw partition size, mounted size, and GC reserve\n");
	printk("are shown separately.\n");

	zms_fp_scan_table(&ctx, ZMS_FP_TABLE_MESH,
			  "Mesh settings (non-RPL, bt/mesh except RPL/)");
	zms_fp_scan_table(&ctx, ZMS_FP_TABLE_RPL, "RPL (bt/mesh/RPL/)");

	err = flash_area_open(PARTITION_ID(storage_partition), &fa);
	if (err) {
		printk("Summary: mesh=%u rpl=%u (partition open err %d)\n",
		       ctx.mesh_key_count, ctx.rpl_key_count, err);
		return;
	}

	partition_size = fa->fa_size;
	flash_area_close(fa);

	free_space = zms_calc_free_space(fs);
	if (free_space < 0) {
		printk("Summary: mesh=%u rpl=%u (free_space err %zd)\n",
		       ctx.mesh_key_count, ctx.rpl_key_count, free_space);
		return;
	}

	logical_sum = ctx.mesh_sum_row_total + ctx.rpl_sum_row_total;
	mounted_size = zms_mounted_size(fs);

	if (partition_size < mounted_size) {
		printk("Summary: partition smaller than mounted ZMS (%zu < %zu)\n",
		       partition_size, mounted_size);
		return;
	}

	free_space_u = (size_t)free_space;
	if (free_space_u > mounted_size) {
		printk("Summary: free space larger than mounted ZMS (%zu > %zu)\n",
		       free_space_u, mounted_size);
		return;
	}

	partition_tail = partition_size - mounted_size;
	mounted_used = mounted_size - free_space_u;
	gc_reserve_size = fs->sector_size;
	overhead_excl_gc = 0U;
	if (mounted_used > (logical_sum + gc_reserve_size)) {
		overhead_excl_gc = mounted_used - logical_sum - gc_reserve_size;
	}

	printk("\n--- Summary ---\n");
	printk("mesh keys:           %u\n", ctx.mesh_key_count);
	printk("mesh sum row_total:  %zu B\n", ctx.mesh_sum_row_total);
	printk("RPL keys:            %u\n", ctx.rpl_key_count);
	printk("RPL sum row_total:   %zu B\n", ctx.rpl_sum_row_total);
	printk("logical sum:         %zu B (live rows only)\n", logical_sum);
	printk("\n");
	printk("raw partition size:  %zu B\n", partition_size);
	printk("unmounted tail:      %zu B\n", partition_tail);
	printk("\n");
	printk("mounted ZMS size:    %zu B (%u sectors x %u B)\n", mounted_size,
		fs->sector_count, fs->sector_size);
	printk("gc reserve (1 sect): %zu B\n", gc_reserve_size);
	printk("mounted free:        %zd B\n", free_space);
	printk("mounted used:        %zu B (incl. GC reserve)\n", mounted_used);
	printk("ZMS overhead ex. GC: %zu B\n", overhead_excl_gc);
	printk("=== end ===\n\n");
}
```

## src/zms_footprint_dbg.h
```c
/*
 * Copyright (c) 2026 Nordic Semiconductor ASA
 *
 * SPDX-License-Identifier: LicenseRef-Nordic-5-Clause
 */

#ifndef ZMS_FOOTPRINT_DBG_H__
#define ZMS_FOOTPRINT_DBG_H__

/** Dump ZMS settings footprint for non-RPL keys (printk). */
void zms_footprint_dbg_dump(void);

#endif /* ZMS_FOOTPRINT_DBG_H__ */
```
