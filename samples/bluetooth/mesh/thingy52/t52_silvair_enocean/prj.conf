## CMakeLists.txt
```
#
# Copyright (c) 2021 Nordic Semiconductor ASA
#
# SPDX-License-Identifier: LicenseRef-Nordic-5-Clause
#
cmake_minimum_required(VERSION 3.20.0)

find_package(Zephyr REQUIRED HINTS $ENV{ZEPHYR_BASE})
project(mesh_silvair_enocean)

# NORDIC SDK APP START
target_sources(app PRIVATE
	src/main.c
	src/model_handler.c
	src/lc_pwm_led.c)
target_include_directories(app PRIVATE include)
# NORDIC SDK APP END
```

## prj.conf
```kconfig
#
# Copyright (c) 2021 Nordic Semiconductor ASA
#
# SPDX-License-Identifier: LicenseRef-Nordic-5-Clause
#
CONFIG_NCS_SAMPLES_DEFAULTS=y

# Deffered logging helps improve LPN power consumption
# when friendship is established.
CONFIG_LOG_MODE_DEFERRED=y

# General configuration
CONFIG_SYSTEM_WORKQUEUE_STACK_SIZE=2048
CONFIG_FLASH=y
CONFIG_FLASH_MAP=y
CONFIG_NVS=y
CONFIG_NVS_LOOKUP_CACHE=y
CONFIG_SETTINGS=y
CONFIG_SETTINGS_NVS_NAME_CACHE=y
CONFIG_HWINFO=y
CONFIG_DK_LIBRARY=y
CONFIG_PM_SINGLE_IMAGE=y
CONFIG_PM_PARTITION_SIZE_SETTINGS_STORAGE=0x8000
CONFIG_SOC_FLASH_NRF_PARTIAL_ERASE=y
CONFIG_LOG_BACKEND_RTT_OUTPUT_BUFFER_SIZE=64
CONFIG_LOG_BUFFER_SIZE=1200
CONFIG_SEGGER_RTT_BUFFER_SIZE_UP=2000

# Bluetooth configuration
CONFIG_BT=y
CONFIG_BT_COMPANY_ID=0x0059
CONFIG_BT_DEVICE_NAME="T52 Mesh Silvair EnOcean"
CONFIG_BT_L2CAP_TX_BUF_COUNT=8
CONFIG_BT_OBSERVER=y
CONFIG_BT_PERIPHERAL=y
CONFIG_BT_SETTINGS=y
CONFIG_BT_HOST_CCM=y

# Disable unused Bluetooth features
CONFIG_BT_CTLR_DUP_FILTER_LEN=0
CONFIG_BT_CTLR_LE_ENC=n
CONFIG_BT_PHY_UPDATE=n
CONFIG_BT_CTLR_CHAN_SEL_2=n
CONFIG_BT_CTLR_MIN_USED_CHAN=n
CONFIG_BT_CTLR_PRIVACY=n

# Bluetooth mesh configuration
CONFIG_BT_MESH=y
CONFIG_BT_MESH_RELAY=y
CONFIG_BT_MESH_FRIEND=y
CONFIG_BT_MESH_ADV_BUF_COUNT=64
CONFIG_BT_MESH_TX_SEG_MAX=32
CONFIG_BT_MESH_PB_GATT=y
CONFIG_BT_MESH_PROXY_USE_DEVICE_NAME=y
CONFIG_BT_MESH_GATT_PROXY=y
CONFIG_BT_MESH_ADV_EXT_GATT_SEPARATE=y
CONFIG_BT_MESH_DK_PROV=y
CONFIG_BT_MESH_NLC_PERF_CONF=y
CONFIG_BT_MESH_NETWORK_TRANSMIT_COUNT=2
CONFIG_BT_MESH_RELAY_RETRANSMIT_COUNT=2

# Bluetooth mesh models
CONFIG_BT_MESH_DTT_SRV=y
CONFIG_BT_MESH_SILVAIR_ENOCEAN_SRV=y
CONFIG_BT_MESH_SILVAIR_ENOCEAN_AUTO_COMMISSION=y

CONFIG_BT_MESH_MODEL_KEY_COUNT=3
CONFIG_SETTINGS_NVS_NAME_CACHE=y
CONFIG_SETTINGS_NVS_NAME_CACHE_SIZE=300
CONFIG_NVS_LOOKUP_CACHE=y
```

## src/main.c
```c
/*
 * Copyright (c) 2021 Nordic Semiconductor ASA
 *
 * SPDX-License-Identifier: LicenseRef-Nordic-5-Clause
 */

/** @file
 *  @brief Nordic mesh Silvair EnOcean sample
 */
#include <zephyr/bluetooth/bluetooth.h>
#include <bluetooth/mesh/models.h>
#include <bluetooth/mesh/dk_prov.h>
#include <dk_buttons_and_leds.h>
#include "lc_pwm_led.h"
#include "model_handler.h"

static void bt_ready(int err)
{
	if (err) {
		printk("Bluetooth init failed (err %d)\n", err);
		return;
	}

	printk("Bluetooth initialized\n");

	(void) dk_leds_init();
	(void) dk_buttons_init(NULL);

	err = bt_mesh_init(bt_mesh_dk_prov_init(), model_handler_init());
	if (err) {
		printk("Initializing mesh failed (err %d)\n", err);
		return;
	}

	if (IS_ENABLED(CONFIG_SETTINGS)) {
		settings_load();
	}

	/* This will be a no-op if settings_load() loaded provisioning info */
	bt_mesh_prov_enable(BT_MESH_PROV_ADV | BT_MESH_PROV_GATT);

	printk("Mesh initialized\n");

	model_handler_start();

	lc_pwm_led_init();
}

int main(void)
{
	int err;

	printk("Initializing...\n");
	err = bt_enable(bt_ready);
	if (err) {
		printk("Bluetooth init failed (err %d)\n", err);
	}

	return 0;
}
```

## include/model_handler.h
```c
/*
 * Copyright (c) 2021 Nordic Semiconductor ASA
 *
 * SPDX-License-Identifier: LicenseRef-Nordic-5-Clause
 */

/**
 * @file
 * @brief Model handler
 */

#ifndef MODEL_HANDLER_H__
#define MODEL_HANDLER_H__

#include <zephyr/bluetooth/mesh.h>

#ifdef __cplusplus
extern "C" {
#endif

const struct bt_mesh_comp *model_handler_init(void);
void model_handler_start(void);

#ifdef __cplusplus
}
#endif

#endif /* MODEL_HANDLER_H__ */
```

## src/lc_pwm_led.c
```c
/*
 * Copyright (c) 2020 Nordic Semiconductor ASA
 *
 * SPDX-License-Identifier: LicenseRef-Nordic-5-Clause
 */

#include <bluetooth/mesh/models.h>
#include <zephyr/drivers/pwm.h>
#include <zephyr/drivers/gpio.h>
#include <zephyr/drivers/gpio/gpio_sx1509b.h>

#if DT_NODE_HAS_STATUS(DT_NODELABEL(sx1509b), okay)
	/* Thingy52 detected */
#else
	#error "Unsupported board: sx1509b devicetree alias is not defined"
#endif

#define PWM_PERIOD 255

#define NUMBER_OF_LEDS 3
#define GREEN_LED DT_GPIO_PIN(DT_NODELABEL(led0), gpios)
#define BLUE_LED DT_GPIO_PIN(DT_NODELABEL(led1), gpios)
#define RED_LED DT_GPIO_PIN(DT_NODELABEL(led2), gpios)

const struct device *sx1509b_dev;

static const gpio_pin_t rgb_pins[] = {
	RED_LED,
	GREEN_LED,
	BLUE_LED,
};

void lc_pwm_led_init(void)
{
	sx1509b_dev = DEVICE_DT_GET(DT_NODELABEL(sx1509b));

	if (!device_is_ready(sx1509b_dev)) {
		printk("sx1509b: device not ready.\n");
		return;
	}

	for (int i = 0; i < NUMBER_OF_LEDS; i++) {
		int err = sx1509b_led_intensity_pin_configure(sx1509b_dev,
							  rgb_pins[i]);
		if (err) {
			printk("Error configuring pin for LED intensity\n");
		}
	}
}

void lc_pwm_led_set(uint16_t desired_lvl)
{
	uint32_t scaled_lvl =
		(PWM_PERIOD * desired_lvl) /
		BT_MESH_LIGHTNESS_MAX;

	for (int i = 0; i < NUMBER_OF_LEDS; i++) {
		sx1509b_led_intensity_pin_set(sx1509b_dev, rgb_pins[i], scaled_lvl);
	}
}
```

## src/model_handler.c
```c
/*
 * Copyright (c) 2021 Nordic Semiconductor ASA
 *
 * SPDX-License-Identifier: LicenseRef-Nordic-5-Clause
 */
/**
 * @file
 * @brief Model handler for the Silvair EnOcean sample.
 *
 * Instantiates a Silvair EnOcean Proxy Server model on the devkit, as well as
 * the standard Config and Health Server models. Handles all application
 * behavior related to the models.
 */
#include <zephyr/bluetooth/bluetooth.h>
#include <bluetooth/mesh/models.h>
#include <bluetooth/enocean.h>
#include <bluetooth/mesh/vnd/silvair_enocean_srv.h>
#include <dk_buttons_and_leds.h>
#include "model_handler.h"
#include "lc_pwm_led.h"

#include <zephyr/logging/log.h>
LOG_MODULE_REGISTER(model_handler, LOG_LEVEL_INF);

static struct bt_mesh_dtt_srv dtt_srv = BT_MESH_DTT_SRV_INIT(NULL);

/* Silvair Enocean Proxy behavior */
static void onoff_status(struct bt_mesh_onoff_cli *cli,
			 struct bt_mesh_msg_ctx *ctx,
			 const struct bt_mesh_onoff_status *status);

static void level_status(struct bt_mesh_lvl_cli *cli,
			 struct bt_mesh_msg_ctx *ctx,
			 const struct bt_mesh_lvl_status *status);

struct bt_mesh_silvair_enocean_srv silvair_enocean = {
	.buttons[0 ... 1] = { .onoff = BT_MESH_ONOFF_CLI_INIT(&onoff_status),
			      .lvl = BT_MESH_LVL_CLI_INIT(&level_status), },
};

static void onoff_status(struct bt_mesh_onoff_cli *cli,
			 struct bt_mesh_msg_ctx *ctx,
			 const struct bt_mesh_onoff_status *status)
{
	struct bt_mesh_silvair_enocean_button *button =
		CONTAINER_OF(cli, struct bt_mesh_silvair_enocean_button, onoff);
	int index = button - &silvair_enocean.buttons[0];

	dk_set_led(index, status->present_on_off);

	printk("Button %d: Received onoff response: %s\n", index + 1,
	       status->present_on_off ? "on" : "off");
}

static void level_status(struct bt_mesh_lvl_cli *cli,
			 struct bt_mesh_msg_ctx *ctx,
			 const struct bt_mesh_lvl_status *status)
{
	struct bt_mesh_silvair_enocean_button *button =
		CONTAINER_OF(cli, struct bt_mesh_silvair_enocean_button, lvl);
	int index = button - &silvair_enocean.buttons[0];

	dk_set_led(index, status->current != BT_MESH_LVL_MIN);

	printk("Button %d: Received level response: current: %d\n", index + 1,
		status->current);
}

/* Set up a repeating delayed work to blink the DK's LEDs when attention is
 * requested.
 */
static struct k_work_delayable attention_blink_work;
static bool attention;

static void attention_blink(struct k_work *work)
{
	static int i;

	if (attention) {
		lc_pwm_led_set(i++ % 2 ? 0xFFFF : 0);
		k_work_reschedule(&attention_blink_work, K_MSEC(50));
	} else {
		lc_pwm_led_set(0);
	}
}

static void attention_on(struct bt_mesh_model *mod)
{
	attention = true;
	k_work_reschedule(&attention_blink_work, K_NO_WAIT);
}

static void attention_off(struct bt_mesh_model *mod)
{
	/* Will stop rescheduling blink timer */
	attention = false;
}

static const struct bt_mesh_health_srv_cb health_srv_cb = {
	.attn_on = attention_on,
	.attn_off = attention_off,
};

static struct bt_mesh_health_srv health_srv = {
	.cb = &health_srv_cb,
};

BT_MESH_HEALTH_PUB_DEFINE(health_pub, 0);

#if IS_ENABLED(CONFIG_BT_MESH_NLC_PERF_CONF)
static const uint8_t cmp2_elem_offset1[2] = { 0, 1 };
static const uint8_t cmp2_elem_offset2[2] = { 0, 1 };

static const struct bt_mesh_comp2_record comp_rec[3] = {
	{
	.id = BT_MESH_NLC_PROFILE_ID_DIMMING_CONTROL,
	.version.x = 1,
	.version.y = 0,
	.version.z = 0,
	.elem_offset_cnt = 2,
	.elem_offset = cmp2_elem_offset1,
	.data_len = 0
	},
	{
	.id = BT_MESH_NLC_PROFILE_ID_DIMMING_CONTROL,
	.version.x = 1,
	.version.y = 0,
	.version.z = 0,
	.elem_offset_cnt = 2,
	.elem_offset = cmp2_elem_offset2,
	.data_len = 0
	}
};

static const struct bt_mesh_comp2 comp_p2 = {
	.record_cnt = 3,
	.record = comp_rec
};
#endif


static struct bt_mesh_elem elements[] = {
	BT_MESH_ELEM(1,
		BT_MESH_MODEL_LIST(BT_MESH_MODEL_CFG_SRV,
				   BT_MESH_MODEL_HEALTH_SRV(&health_srv,
							    &health_pub),
				   BT_MESH_MODEL_DTT_SRV(&dtt_srv),
				   BT_MESH_MODEL_SILVAIR_ENOCEAN_BUTTON(
					&silvair_enocean, 0)),
		BT_MESH_MODEL_LIST(BT_MESH_MODEL_SILVAIR_ENOCEAN_SRV(
					&silvair_enocean))),
	BT_MESH_ELEM(2,
		BT_MESH_MODEL_LIST(BT_MESH_MODEL_SILVAIR_ENOCEAN_BUTTON(
					&silvair_enocean, 1)),
		BT_MESH_MODEL_NONE),
};

static const struct bt_mesh_comp comp = {
	.cid = CONFIG_BT_COMPANY_ID,
	.elem = elements,
	.elem_count = ARRAY_SIZE(elements),
};

void model_handler_start(void)
{
#if IS_ENABLED(CONFIG_BT_MESH_NLC_PERF_CONF)
	if (bt_mesh_comp2_register(&comp_p2)) {
		printf("Failed to register comp2\n");
	}
#endif
}

const struct bt_mesh_comp *model_handler_init(void)
{
	k_work_init_delayable(&attention_blink_work, attention_blink);

	return &comp;
}
```
